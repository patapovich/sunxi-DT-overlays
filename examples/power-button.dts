/dts-v1/;
/plugin/;

/ {
	compatible = "allwinner,sun8i-h3";

	fragment@0 {
		target = <sw4>;
		__overlay__ {
			label = "Power key";
			linux,code = <116>;
			gpios = <&r_pio 0 3 GPIO_ACTIVE_LOW>;
		};
	};
};
